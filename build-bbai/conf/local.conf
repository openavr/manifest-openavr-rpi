## build-bbai/conf/local.conf
```bitbake
MACHINE = "beagleboneai"
DISTRO = "openavr"

require ${TOPDIR}/../scripts/conf/local-common.conf
```

## build-bbb/conf/bblayers.conf
```bitbake
# POKY_BBLAYERS_CONF_VERSION is increased each time build/conf/bblayers.conf
# changes incompatibly
POKY_BBLAYERS_CONF_VERSION = "2"

BBPATH = "${TOPDIR}"
BBFILES ?= ""

BBLAYERS ?= " \
  ${TOPDIR}/../oe/poky/meta \
  ${TOPDIR}/../oe/poky/meta-poky \
  ${TOPDIR}/../oe/poky/meta-yocto-bsp \
  ${TOPDIR}/../oe/meta-oe/meta-oe \
  ${TOPDIR}/../oe/meta-oe/meta-networking \
  ${TOPDIR}/../oe/meta-oe/meta-python \
  ${TOPDIR}/../oe/meta-openavr \
  "
```

## build-rpi4/conf/local.conf
```bitbake
MACHINE = "raspberrypi4"
DISTRO = "openavr"

require ${TOPDIR}/../scripts/conf/local-common.conf
```
